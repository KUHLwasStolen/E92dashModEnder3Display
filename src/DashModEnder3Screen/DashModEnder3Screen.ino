#include <SPI.h>
#include <U8g2lib.h>
#include <mcp2515_can.h>

#define _USE_MATH_DEFINES
#include <math.h>

#define LCD_POWER_PIN 27
#define ENC_PIN 26
#define LCD_CS_PIN 14
#define LCD_SCK_PIN 13
#define LCD_MOSI_PIN 12
#define CAN_CS_PIN 5

U8G2_ST7920_128X64_F_SW_SPI u8g2(U8G2_R0, LCD_SCK_PIN, LCD_MOSI_PIN, LCD_CS_PIN);
unsigned char lcdState = 1; // 0 = off, 1 = page 1
#define LCDSTATE_COUNT 2 // number of available states of the lcd

bool clutchPressed = true;
bool brakePressed = false;
short engineTemp = 91;
unsigned short engineRpm = 3945;
double engineTorque = 319.1948347;
double batteryVoltage = 12.41123;
double throttlePercentage = 0.6789; // throttle from 0 (foot off paddle) to 1 (flat)
double steeringPosition = 0.4567; // -1 -> fully (600°) to the left, 0 -> centered, 1 -> fully (600°) to the right

mcp2515_can CAN(CAN_CS_PIN);

TaskHandle_t DataTask;
TaskHandle_t RenderingTask;
TaskHandle_t UserInputTask;

void setup() {
  Serial.begin(115200);
  pinMode(LCD_POWER_PIN, OUTPUT);
  pinMode(ENC_PIN, INPUT);

  digitalWrite(LCD_POWER_PIN, HIGH); // turn on lcd
  
  u8g2.begin(); // initialize lcd
  u8g2.setFont(u8g2_font_6x10_mr);

  showStartupLogo(2500);

  /* ATTENTION: We are interfacing a 500KBPS CAN bus but need to use the 1000KBPS variable
     This is needed because the library expects a MCP module with a 16MHz crystal on it
     Check if your crystal (usually shiny, oval) has an 8 or 16 written on it
     if 8 --> use CAN_1000KBPS          if 16 --> use CAN_500KBPS
     This also applies to other CAN bus speeds of course, always double the speed if you have an 8MHz crystal */
  while (CAN_OK != CAN.begin(CAN_1000KBPS)) {
    Serial.println("CAN bus init failed! Retrying in 250...");
    displayErrorMessage("CAN init failed!");
    delay(250);
  }
  Serial.println("CAN bus initialized successfully");

  xTaskCreatePinnedToCore(
                    dataTaskCode,   // Task function.
                    "dataTask",     // name of task.
                    10000,          // Stack size of task
                    NULL,           // parameter of the task
                    1,              // priority of the task
                    &DataTask,      // Task handle to keep track of created task
                    1);             // pin task to core 1

  xTaskCreatePinnedToCore(
                    renderingTaskCode,    // Task function
                    "renderingTask",      // name of task
                    10000,                // Stack size of task
                    NULL,                 // parameter of the task
                    1,                    // priority of the task
                    &RenderingTask,       // Task handle to keep track of created task
                    0);                   // pin task to core 0

  xTaskCreatePinnedToCore(
                    userInputTaskCode,    // Task function
                    "userInputTask",      // name of task
                    10000,                // Stack size of task
                    NULL,                 // parameter of the task
                    1,                    // priority of the task
                    &UserInputTask,       // Task handle to keep track of created task
                    0);                   // pin task to core 0

}


void loop() {
}


void dataTaskCode(void * params) {
  Serial.print("Data task running on core ");
  Serial.println(xPortGetCoreID());

  unsigned char len = 0;
  unsigned char buf[8];

  while(1) {
    if (CAN_MSGAVAIL == CAN.checkReceive()) {
      CAN.readMsgBuf(&len, buf);
      unsigned long canId = CAN.getCanId();

      Serial.print("Data from ID: 0x");
      Serial.println(canId, HEX);
      for (int i = 0; i < len; i++) {
        Serial.print(buf[i], HEX);
        Serial.print("\t");
      }
      Serial.println();
    }
  }
}


void userInputTaskCode(void * params) {
  Serial.print("User input task running on core ");
  Serial.println(xPortGetCoreID());

  while(1) {
    if(digitalRead(ENC_PIN) == 0) {
      Serial.println("Encoder button pressed");

      if(lcdState == 0) {
        // Turn on lcd
        Serial.println("Turning on LCD");
        digitalWrite(LCD_POWER_PIN, HIGH);
      }

      lcdState = (lcdState + 1) % LCDSTATE_COUNT;

      if(lcdState == 0) {
        // Turn off lcd
        Serial.println("Turning off LCD");
        digitalWrite(LCD_POWER_PIN, LOW);
      }

      delay(450); // avoid multiple triggers on one press
    }

    delay(1); // to avoid triggering the watchdog timeout
  }
}


void renderingTaskCode(void * params) {
  Serial.print("Rendering task running on core ");
  Serial.println(xPortGetCoreID());

  while(1) {
    updateDisplay();
    delay(100);
  }
}


// displays the current vehicle information
void updateDisplay() {
  switch(lcdState) {
    // lcd off case
    case 0: break;

    // displays engineTemp, enginePower, engineTorque, batteryVoltage, clutchPressed, brakePressed, throttlePercentage, steeringPosition 
    case 1:
      char outputStr[10];
      u8g2.firstPage();
      do {
        u8g2.drawStr(1, 8, "Enginetemp.:");
        getEngineTempStr(outputStr);
        u8g2.drawUTF8(81, 8, outputStr);

        // Calculated engine power from torque and rpm
        u8g2.drawStr(1, 18, "Enginepower:");
        getEnginePowerStr(outputStr);
        u8g2.drawStr(81, 18, outputStr);

        u8g2.drawStr(1, 28, "Torque     :");
        getEngineTorqueStr(outputStr);
        u8g2.drawStr(81, 28, outputStr);

        u8g2.drawStr(1, 38, "Battvoltage:");
        getBatteryVoltageStr(outputStr);
        u8g2.drawStr(81, 38, outputStr);

        // Clutch status
        u8g2.drawButtonUTF8(32, 50, U8G2_BTN_HCENTER | U8G2_BTN_BW1 | (clutchPressed ? U8G2_BTN_INV : 0), 62,  0,  1, "Clutch" );

        // Brake status
        u8g2.drawButtonUTF8(96, 50, U8G2_BTN_HCENTER | U8G2_BTN_BW1 | (brakePressed ? U8G2_BTN_INV : 0), 62,  0,  1, "Brake" );

        // Throttle position
        u8g2.drawBox(0, 55, round(throttlePercentage * 128.0d), 5);

        // Steering position
        int barWidth = round(steeringPosition * 64.0d);
        if(barWidth >= 0) {
          u8g2.drawBox(64, 61, barWidth, 3);
        } else {
          u8g2.drawBox(64 + barWidth, 61, abs(barWidth), 3);
        }
        
      } while ( u8g2.nextPage() );
    break;
  }
}


// ### Rendering helper methods ###
void getEngineTempStr(char* tempStr) {
  sprintf(tempStr, "%+d C", engineTemp);
}

void getEnginePowerStr(char* powStr) {
  double enginePower = ((double)engineRpm * engineTorque * ((2.0d * PI) / 60.0d)) / 1000.0d;
  sprintf(powStr, "%d kW", (int)abs(round(enginePower)));
}

void getEngineTorqueStr(char* torqueStr) {
  sprintf(torqueStr, "%d Nm", (int)abs(round(engineTorque)));
}

void getBatteryVoltageStr(char* voltStr) {
  sprintf(voltStr, "%.2lf V", batteryVoltage);
}


// ### CAN conversion methods ordered by ID ###
// from 0x0A8
void setEngineTorque(unsigned char byte1, unsigned char byte2) {
  // from loopbunny.co.uk: "This reports the real-time torque value the engine is currently producing. This value is twos compliment and can also be negative"

  signed short combined = ((unsigned short)byte2 << 8) + (unsigned short)byte1;
  engineTorque = (double)combined / 32.0d;
}

// from 0x0A8
void setClutchPressed(unsigned char byte5) {
  unsigned char shifted = byte5 << 7; // only interested in first bit, shift rest out

  if(shifted == 128) {
    clutchPressed = true;
  } else {
    clutchPressed = false;
  }
}

// from 0x0A8
void setBrakePressed(unsigned char byte7) {
  if(byte7 > 20) {
    brakePressed = true;
  } else {
    brakePressed = false;
  }
}

// from 0x0AA
void setEngineRpm(unsigned char byte4, unsigned char byte5) {
  engineRpm = round((float)(((unsigned short)byte5 << 8) + (unsigned short)byte4) / 4.0f);
}

// from 0x0AA
void setThrottlePercentage(unsigned char byte2, unsigned char byte3) {
  // value between 255 and 65064 (don't ask me why)
  unsigned short combined = ((unsigned short)byte3 << 8) + (unsigned short)byte2;

  throttlePercentage = (double)(combined - 255) / (double)(65064 - 255);
}

// from 0x0C8
void setSteeringPosition(unsigned char byte0, unsigned char byte1) {
  // value is in 2s compliment (can be negative), to get the angle in degrees devide by 23
  // negative means to the left and positive to the right --> value between -12800 and +12800
  signed short combined = ((unsigned short)byte1 << 8) + (unsigned short) byte0;

  steeringPosition = (double)combined / 12800.0d;
}

// from 0x1D0
void setEngineTemp(unsigned char byte0) {
  engineTemp = (signed short)byte0 - 48;
}

// from 0x3B4
void setBatteryVoltage(unsigned char byte0, unsigned char byte1) {
  // (((Byte[1]-240 )*256)+Byte[0])/68 
  batteryVoltage = (double)(((unsigned short)(byte1 - (unsigned char)0xF0) << 8) + (unsigned char)byte0) / 68.0d;
}


// ### General visual helper methods
// displays a simple one line string on the lcd
void displayErrorMessage(char * message) {
  u8g2.firstPage();
  do {
    u8g2.setCursor(1,8);
    u8g2.print(message);
  } while ( u8g2.nextPage() );
}

// displays a simple BMW logo on the lcd for the given amount of time
void showStartupLogo(int duration) {
  // 'bmw-2-logo-png-transparent', 128x64px
  const unsigned char bmwLogo [] PROGMEM = {
    0xff, 0xff, 0xff, 0xff, 0xff, 0xff, 0xff, 0x03, 0xc0, 0xff, 0xff, 0xff, 0xff, 0xff, 0xff, 0xff, 
    0xff, 0xff, 0xff, 0xff, 0xff, 0xff, 0x3f, 0x00, 0x00, 0xfc, 0xff, 0xff, 0xff, 0xff, 0xff, 0xff, 
    0xff, 0xff, 0xff, 0xff, 0xff, 0xff, 0x0f, 0x00, 0x00, 0xf0, 0xff, 0xff, 0xff, 0xff, 0xff, 0xff, 
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    0xff, 0xff, 0xff, 0xff, 0xff, 0xff, 0xff, 0x03, 0xc0, 0xff, 0xff, 0xff, 0xff, 0xff, 0xff, 0xff
  };

  u8g2.clearBuffer();
  u8g2.drawXBMP(0,0,128,64,bmwLogo);
  u8g2.sendBuffer();

  delay(duration);
}